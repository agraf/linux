## Documentation/devicetree/bindings/kho/ftrace/ftrace-array.yaml
```yaml
# SPDX-License-Identifier: (GPL-2.0-only OR BSD-2-Clause)
%YAML 1.2
---
$id: http://devicetree.org/schemas/kho/ftrace/ftrace-array.yaml#
$schema: http://devicetree.org/meta-schemas/core.yaml#

title: Ftrace trace array

maintainers:
  - Alexander Graf <graf@amazon.com>

properties:
  compatible:
    enum:
      - ftrace,array-v1

  trace_flags:
    $ref: /schemas/types.yaml#/definitions/uint32
    description:
      Bitmap of all the trace flags that were enabled in the trace array at the
      point of serialization.

# Subnodes will be of type "ftrace,cpu-v1", one each per CPU
additionalProperties: true

required:
  - compatible
  - trace_flags

examples:
  - |
    ftrace {
        compatible = "ftrace-v1";
        events = <1 1 2 2 3 3>;

        global_trace {
          compatible = "ftrace,array-v1";
          trace_flags = < 0x3354601 >;

          cpu0 {
            compatible = "ftrace,cpu-v1";
            cpu = < 0x00 >;
            mem = < 0x101000000ULL 0x38ULL 0x101000100ULL 0x1000ULL 0x101000038ULL 0x38ULL 0x101002000ULL 0x1000ULL>;
          };
        };
      };
```

## Documentation/devicetree/bindings/kho/ftrace/ftrace-cpu.yaml
```yaml
# SPDX-License-Identifier: (GPL-2.0-only OR BSD-2-Clause)
%YAML 1.2
---
$id: http://devicetree.org/schemas/kho/ftrace/ftrace-cpu.yaml#
$schema: http://devicetree.org/meta-schemas/core.yaml#

title: Ftrace per-CPU ring buffer contents

maintainers:
  - Alexander Graf <graf@amazon.com>

properties:
  compatible:
    enum:
      - ftrace,cpu-v1

  cpu:
    $ref: /schemas/types.yaml#/definitions/uint32
    description:
      CPU number of the CPU that this ring buffer belonged to when it was
      serialized.

  mem:
    $ref: /schemas/types.yaml#/definitions/uint32-array
    description:
      Array of { u64 phys_addr, u64 len } elements that describe a list of ring
      buffer pages. Each page consists of two elements. The first element
      describes the location of the struct buffer_page that contains metadata
      for a given ring buffer page, such as the ring's head indicator. The
      second element points to the ring buffer data page which contains the raw
      trace data.

additionalProperties: false

required:
  - compatible
  - cpu
  - mem

examples:
  - |
    ftrace {
        compatible = "ftrace-v1";
        events = <1 1 2 2 3 3>;

        global_trace {
          compatible = "ftrace,array-v1";
          trace_flags = < 0x3354601 >;

          cpu0 {
            compatible = "ftrace,cpu-v1";
            cpu = < 0x00 >;
            mem = < 0x101000000ULL 0x38ULL 0x101000100ULL 0x1000ULL 0x101000038ULL 0x38ULL 0x101002000ULL 0x1000ULL>;
          };
        };
      };
```

## Documentation/devicetree/bindings/kho/ftrace/ftrace.yaml
```yaml
# SPDX-License-Identifier: (GPL-2.0-only OR BSD-2-Clause)
%YAML 1.2
---
$id: http://devicetree.org/schemas/kho/ftrace/ftrace.yaml#
$schema: http://devicetree.org/meta-schemas/core.yaml#

title: Ftrace core data

maintainers:
  - Alexander Graf <graf@amazon.com>

properties:
  compatible:
    enum:
      - ftrace-v1

  events:
    $ref: /schemas/types.yaml#/definitions/uint32-array
    description:
      Array of { u32 crc, u32 type } elements. Each element contains a unique
      identifier for an event, followed by the identifier that this event had
      in the previous kernel's trace buffers.

# Other child nodes will be of type "ftrace,array-v1". Each of which describe
# a trace buffer
additionalProperties: true

required:
  - compatible
  - events

examples:
  - |
    ftrace {
        compatible = "ftrace-v1";
        events = <1 1 2 2 3 3>;

        global_trace {
          compatible = "ftrace,array-v1";
          trace_flags = < 0x3354601 >;

          cpu0 {
            compatible = "ftrace,cpu-v1";
            cpu = < 0x00 >;
            mem = < 0x101000000ULL 0x38ULL 0x101000100ULL 0x1000ULL 0x101000038ULL 0x38ULL 0x101002000ULL 0x1000ULL>;
          };
        };
      };
```
